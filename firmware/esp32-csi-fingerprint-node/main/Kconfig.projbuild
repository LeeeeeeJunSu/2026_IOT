## firmware/esp32-csi-fingerprint-node/main/Kconfig.projbuild
```kconfig
menu "CSI Fingerprinting Node Configuration"

    config CSI_DEFAULT_WIFI_SSID
        string "Default WiFi SSID"
        default ""
        help
            Fallback SSID used when NVS does not contain provisioning data.

    config CSI_DEFAULT_WIFI_PASSWORD
        string "Default WiFi password"
        default ""
        help
            Fallback password used when NVS does not contain provisioning data.

    config CSI_DEFAULT_TARGET_IP
        string "Default UDP target IP"
        default "192.168.1.100"
        help
            Desktop app or collector IP address for the UDP CSI stream.

    config CSI_DEFAULT_TARGET_PORT
        int "Default UDP target port"
        default 5005
        range 1024 65535
        help
            UDP port used by the desktop fingerprinting app.

    config CSI_DEFAULT_SEND_INTERVAL_MS
        int "Default CSI UDP send interval in milliseconds"
        default 20
        range 0 1000
        help
            Minimum interval between UDP CSI frames sent by one node. Use 0 to send every CSI callback.

    config CSI_DEFAULT_NODE_ID
        int "Default node ID"
        default 1
        range 0 255
        help
            Unique node identifier encoded into ADR-018 frames.

    config CSI_DEFAULT_WIFI_CHANNEL
        int "Default WiFi channel"
        default 6
        range 1 13
        help
            Expected WiFi channel for the access point.

endmenu
```

## firmware/esp32-csi-fingerprint-node/sdkconfig.defaults
```kconfig
CONFIG_IDF_TARGET="esp32s3"
CONFIG_ESP_WIFI_CSI_ENABLED=y
CONFIG_ESPTOOLPY_FLASHSIZE_4MB=y
CONFIG_PARTITION_TABLE_CUSTOM=y
CONFIG_PARTITION_TABLE_CUSTOM_FILENAME="partitions.csv"
CONFIG_CSI_DEFAULT_SEND_INTERVAL_MS=20
```
